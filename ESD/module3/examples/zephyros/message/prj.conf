## CMakeLists.txt
```
# SPDX-License-Identifier: Apache-2.0

cmake_minimum_required(VERSION 3.20.0)

find_package(Zephyr REQUIRED HINTS $ENV{ZEPHYR_BASE})

project(message)

FILE(GLOB app_sources src/*.cpp)

target_sources(app PRIVATE ${app_sources})
```

## prj.conf
```kconfig
CONFIG_CPP=y
CONFIG_ADC=y
CONFIG_GPIO=y
CONFIG_PM_DEVICE=y
CONFIG_REQUIRES_FULL_LIBCPP=y
```

## src/main.cpp
```c
#include "random.h"
#include <iostream>
#include <zephyr/kernel.h>
#include <zephyr/drivers/gpio.h>
#include <zephyr/kernel/thread_stack.h>

constexpr int PRIORITY{5};
constexpr int STACKSIZE{512}; // Size of stack area used by each thread

K_THREAD_STACK_DEFINE(stack_area, STACKSIZE);

constexpr int PTIME{500}; // Producing base time
constexpr int CTIME{500}; // Consuming base time

class Product
{
	uint32_t id{0};
	uint32_t price{0};
	const char *name{nullptr};

public:
	Product() = default;
	Product(uint32_t _id, uint32_t _price, const char *_name) : id{_id}, price{_price}, name{_name} {}

	friend std::ostream &operator<<(std::ostream &os, const Product &product)
	{
		os << "ID: " << product.id << std::endl;
		os << "Price: " << product.price << std::endl;
		os << "Name: " << product.name << std::endl;
		return os;
	}
};

// Statically define and initialize a message queue.
// Look at: https://docs.zephyrproject.org/latest/kernel/services/data_passing/message_queues.html
K_MSGQ_DEFINE(store, sizeof(Product), 8, 1); // Max. number of messages is 8

static void consumer(void *param, void *, void *)
{
	Product product;
	uint16_t value{0};
	const uint32_t cid{(uint32_t)param};

	while (1)
	{
		if (0 != k_msgq_get(&store, &product, K_FOREVER))
		{
			printf("Failed to restore a product\n");
		}

		std::cout << "============== Consumer " << cid << " ==============" << std::endl;
		std::cout << product << std::endl;

		random_get((uint8_t *)&value, sizeof(value));
		k_msleep(CTIME + (value % CTIME));
	}
}

// Look at: https://docs.zephyrproject.org/latest/kernel/services/threads/index.html
K_THREAD_DEFINE(cid1, STACKSIZE, consumer, (void *)1, NULL, NULL, PRIORITY, 0, 0);
K_THREAD_DEFINE(cid2, STACKSIZE, consumer, (void *)2, NULL, NULL, PRIORITY, 0, 0);
K_THREAD_DEFINE(cid3, STACKSIZE, consumer, (void *)3, NULL, NULL, PRIORITY, 0, 0);
K_THREAD_DEFINE(cid4, STACKSIZE, consumer, (void *)4, NULL, NULL, PRIORITY, 0, 0);

int main(void)
{
	if (!random_init())
	{
		std::cout << "Failed to seed the random number generator" << std::endl;
		return EXIT_FAILURE;
	}

	uint16_t value;
	Product product;
	const struct gpio_dt_spec led = GPIO_DT_SPEC_GET(DT_ALIAS(led1), gpios);

	k_thread_start(cid1);
	k_thread_start(cid2);
	k_thread_start(cid3);
	k_thread_start(cid4);

	(void)gpio_is_ready_dt(&led);
	(void)gpio_pin_configure_dt(&led, GPIO_OUTPUT_INACTIVE);

	while (1)
	{
		random_get((uint8_t *)&value, sizeof(value));

		switch (value % 4)
		{
		case 0:
			product = Product{100, 1000, "iPhone 14 Pro Max"};
			break;

		case 1:
			product = Product{200, 2000, "Samsung Galaxy S23 5G"};
			break;

		case 2:
			product = Product{300, 3000, "Apple Watch S9 45mm GPS+CEL"};
			break;

		default:
			product = Product{400, 4000, "Samsung Galaxy Watch5 Pro 45mm LTE"};
			break;
		}

		if (0 != k_msgq_put(&store, &product, K_FOREVER))
		{
			std::cout << "Failed to store the product" << std::endl;
		}

		(void)gpio_pin_set_dt(&led, 1);
		k_msleep(PTIME / 4);
		(void)gpio_pin_set_dt(&led, 0);

		k_msleep(3 * PTIME / 4 + (value % PTIME));
	}

	return 0;
}
```

## src/random.cpp
```c
#include "random.h"
#include <cstdlib>
#include <zephyr/device.h>
#include <zephyr/pm/device.h>
#include <zephyr/drivers/adc.h>

bool random_init(void)
{
    bool status{false};

    const struct device *adc = DEVICE_DT_GET(DT_NODELABEL(lpadc0));

    if (device_is_ready(adc))
    {
        constexpr int ADC_CHANNEL{3}; /* ARD_A0, P4_6, ADC0_A3 */
        constexpr adc_gain ADC_GAIN{ADC_GAIN_1};

        adc_channel_cfg config{
            .gain = ADC_GAIN,
            .reference = ADC_REF_EXTERNAL1,
            .acquisition_time = ADC_ACQ_TIME_DEFAULT,
            .channel_id = ADC_CHANNEL,
            .differential = 0,
            .input_positive = ADC_CHANNEL,
        };

        if (0 == adc_channel_setup(adc, &config))
        {
            uint16_t value{0};
            constexpr int ADC_RESOLUTION{12};

            adc_sequence sequence = {
                .channels = BIT(ADC_CHANNEL),
                .buffer = &value,
                .buffer_size = sizeof(value),
                .resolution = ADC_RESOLUTION,
                .oversampling = 4,
                .calibrate = true,
            };

            size_t i{0};
            int32_t seed{0};
            int8_t *ptr{reinterpret_cast<int8_t *>(&seed)};

            status = true;
            while (i < sizeof(seed))
            {
                if (0 == adc_read(adc, &sequence))
                {
                    ptr[i] = value % 256;
                    if ((i == 0) || (ptr[i] != ptr[i - 1]))
                    {
                        i++;
                    }
                    k_msleep(1);
                }
                else
                {
                    status = false;
                    break;
                }
            }

            if (seed < 0)
            {
                seed *= -1;
            }
            srand(seed);
        }

        pm_device_action_run(adc, PM_DEVICE_ACTION_TURN_OFF);
    }

    return status;
}

void random_get(uint8_t *data, size_t size)
{
    for (size_t i = 0; i < size; i++)
    {
        data[i] = rand() % 256;
    }
}
```

## src/random.h
```c
#ifndef RANDOM_H
#define RANDOM_H

#include <cstdint>
#include <cstddef>

bool random_init(void);

void random_get(uint8_t *data, size_t size);

#endif
```
