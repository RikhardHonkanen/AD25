## CMakeLists.txt
```
# SPDX-License-Identifier: Apache-2.0

cmake_minimum_required(VERSION 3.20.0)

find_package(Zephyr REQUIRED HINTS $ENV{ZEPHYR_BASE})

project(exercise-14)

FILE(GLOB app_sources src/*.cpp)

target_sources(app PRIVATE ${app_sources})
```

## prj.conf
```kconfig
CONFIG_LED=y
CONFIG_LOG=y
CONFIG_CPP=y
```

## frdm_mcxn236.overlay
```dts
#include <zephyr/dt-bindings/gpio/gpio.h>

/ {
    leds {
		myled: myled {
			gpios = <&gpio0 24 GPIO_ACTIVE_HIGH>;
			label = "My LED";
		};
    };
};
```

## src/main.cpp
```c
#include <zephyr/kernel.h>
#include <zephyr/sys_clock.h>
#include <zephyr/drivers/led.h>
#include <zephyr/logging/log.h>

LOG_MODULE_REGISTER(myled);

class Metro
{
	uint64_t prev_micros;
	const uint64_t interval;

public:
	Metro(uint64_t _interval) : prev_micros{k_ticks_to_us_floor64(k_uptime_ticks())}, interval{1000 * _interval} {}

	bool check(void)
	{
		bool checked{false};
		uint64_t now{k_ticks_to_us_floor64(k_uptime_ticks())};

		if (now - prev_micros >= interval)
		{
			checked = true;
			prev_micros = now;
		}

		return checked;
	}
};

int main(void)
{
	const struct led_dt_spec led_dev = LED_DT_SPEC_GET(DT_NODELABEL(myled));

	if (!led_is_ready_dt(&led_dev))
	{
		LOG_ERR("LED device %s is not ready", led_dev.dev->name);
		exit(EXIT_FAILURE);
	}

	Metro blink{500};
	Metro hello{1000};

	while (1)
	{
		if (blink.check())
		{
			static bool state{true};
			if (0 != (state ? led_on_dt(&led_dev) : led_off_dt(&led_dev)))
			{
				LOG_ERR("Failed to toggle the LED");
				exit(EXIT_FAILURE);
			}
			state = !state;
		}

		if (hello.check())
		{
			printf("Hello World\r\n");
		}
	}

	return EXIT_SUCCESS;
}
```
