#include <zephyr/dt-bindings/pwm/pwm.h>

/ {
    pwmleds {
        compatible = "pwm-leds";
        pwm_led: pwm_led {
            pwms = <&flexpwm1_pwm0 0 20000000 PWM_POLARITY_NORMAL>; // PWM period is 20000000ns = 20ms
        };
    };
};
